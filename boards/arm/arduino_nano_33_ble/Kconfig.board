## boards/arm/arduino_nano_33_ble/Kconfig.board
```kconfig
# Copyright (c) 2020 Jefferson Lee.
# SPDX-License-Identifier: Apache-2.0

config BOARD_ARDUINO_NANO_33_BLE
    bool "Arduino Nano 33 BLE board"
    depends on SOC_NRF52840_QIAA

config BOARD_ARDUINO_NANO_33_BLE_INIT_ARDUINO_STYLE
    bool "Initializes the boards in the style of the standard Arduino distribution"
    depends on BOARD_ARDUINO_NANO_33_BLE
```

## boards/arm/arduino_nano_33_ble/arduino_nano_33_ble_defconfig
```kconfig
# SPDX-License-Identifier: Apache-2.0

CONFIG_SOC_SERIES_NRF52X=y
CONFIG_SOC_NRF52840_QIAA=y
CONFIG_BOARD_ARDUINO_NANO_33_BLE=y

# Enable MPU
CONFIG_ARM_MPU=y

# enable peripherals
CONFIG_GPIO=y
CONFIG_USB=y
CONFIG_SERIAL=y
CONFIG_I2C=y
CONFIG_SPI=y

# additional board options
CONFIG_GPIO_AS_PINRESET=y
CONFIG_BOOTLOADER_BOSSA=y
CONFIG_BOOTLOADER_BOSSA_ARDUINO=y
```
